#define CONFIG_WIRELESS
#define ZMK_BASE_LAYER(name, LT, RT, LM, RM, LB, RB, LH, RH) \
    ZMK_LAYER(name, LT RT LM RM LB RB LH RH)

#include "zmk-helpers/key-labels/34.h" // Changed to 34-key labels
#include "base.keymap"
